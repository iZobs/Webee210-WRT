## backfire_10.03.1/target/linux/s3c64xx/files-2.6.36/drivers/media/video/samsung/Kconfig
```kconfig
config VIDEO_SAMSUNG
	bool "Samsung Multimedia Devices"
	depends on VIDEO_CAPTURE_DRIVERS && VIDEO_V4L2
	select VIDEO_FIXED_MINOR_RANGES
	default n
	---help---
	  This is a representative video4linux configuration for Samsung multimedia devices.

source "drivers/media/video/samsung/fimc/Kconfig"
source "drivers/media/video/samsung/post/Kconfig"

if CPU_S3C6410
source "drivers/media/video/samsung/mfc10/Kconfig"
source "drivers/media/video/samsung/jpeg/Kconfig"
endif

if CPU_S5PC100
source "drivers/media/video/samsung/mfc40/Kconfig"
source "drivers/media/video/samsung/jpeg_v2/Kconfig"
endif

source "drivers/media/video/samsung/tv/Kconfig"
source "drivers/media/video/samsung/rotator/Kconfig"
source "drivers/media/video/samsung/g2d/Kconfig"
source "drivers/media/video/samsung/g3d/Kconfig"
source "drivers/media/video/samsung/cmm/Kconfig"

if VIDEO_SAMSUNG

comment "Reserved memory configurations"

config VIDEO_SAMSUNG_MEMSIZE_FIMC
	int "Memory size in kbytes for FIMC"
	depends on VIDEO_FIMC
	default "10240"

config VIDEO_SAMSUNG_MEMSIZE_POST
	int "Memory size in kbytes for Post Processor"
	depends on VIDEO_POST
	default "8192"

config VIDEO_SAMSUNG_MEMSIZE_TV
	int "Memory size in kbytes for TV"
	depends on VIDEO_TV
	default "8192"

if CPU_S3C6410
config VIDEO_SAMSUNG_MEMSIZE_MFC
	int "Memory size in kbytes for MFC"
	depends on VIDEO_MFC10
	default "6144"

config VIDEO_SAMSUNG_MEMSIZE_JPEG
	int "Memory size in kbytes for JPEG"
	depends on VIDEO_JPEG 
	default "4096"
endif

if ARCH_S5PC1XX
config VIDEO_SAMSUNG_MEMSIZE_MFC
	int "Memory size in kbytes for MFC"
	depends on VIDEO_MFC40
	default "32768"

config VIDEO_SAMSUNG_MEMSIZE_JPEG
	int "Memory size in kbytes for JPEG"
	depends on VIDEO_JPEG_V2 
	default "32768"
endif

config VIDEO_SAMSUNG_MEMSIZE_CMM
	int "Memory size in kbytes for CMM"
	depends on VIDEO_CMM && CPU_S3C6410
	default "0"
endif
```

## backfire_10.03.1/target/linux/s3c64xx/files-2.6.36/drivers/media/video/samsung/cmm/Kconfig
```kconfig
#
# Configuration for CMM 
#

config VIDEO_CMM
	bool "Samsung CMM Driver" 
	depends on VIDEO_SAMSUNG && CPU_S3C6410
	default n
	---help---
	  This is a CMM driver for Samsung S3C6410.
```

## backfire_10.03.1/target/linux/s3c64xx/files-2.6.36/drivers/media/video/samsung/fimc/Kconfig
```kconfig
if VIDEO_FIMC
comment "FIMC configurations"
endif

config VIDEO_FIMC
	bool "Samsung Camera Interface (FIMC) driver"
	depends on VIDEO_SAMSUNG && (ARCH_S3C64XX || ARCH_S5PC1XX)
	default n
	---help---
	  This is a video4linux driver for Samsung FIMC device.

config VIDEO_FIMC_DEBUG
	bool "FIMC driver debug messages"
	depends on VIDEO_FIMC

config VIDEO_FIMC_MIPI
	bool "FIMC works with MIPI-CSI2 (Rx)"
	depends on VIDEO_FIMC && ARCH_S5PC1XX

source "drivers/media/video/samsung/fimc/Kconfig-camera"

choice
depends on OV965X
prompt "Select source resolution"
default OV965X_VGA
config OV965X_VGA
	bool "VGA(640X480)"
	---help---
	LIYUTAI OV965X camera module support.

config OV965X_QVGA
	bool "QVGA(320X240)"
	---help---
	LIYUTAI OV965X camera module support.

config OV965X_SVGA
	bool "SVGA(800X600)"
	---help---
	LIYUTAI OV965X camera module support.

config OV965X_SXGA
	bool "SXGA(1280X1024)"
	---help---
	LIYUTAI OV965X camera module support.
endchoice

config VIDEO_FIMC_CAM_CH
	int "External Camera channel (0=A, 1=B)"
	depends on VIDEO_FIMC
	default "0"

config VIDEO_FIMC_CAM_RESET
	int "Reset Type (0=low, 1=high)"
	depends on VIDEO_FIMC
	default "0"
```

## backfire_10.03.1/target/linux/s3c64xx/files-2.6.36/drivers/media/video/samsung/fimd/Kconfig
```kconfig
if VIDEO_FIMC
comment "FIMC configurations"
endif

config VIDEO_FIMC
	bool "Samsung Camera Interface (FIMC) driver"
	depends on VIDEO_SAMSUNG
	default n
	---help---
	  This is a video4linux driver for Samsung FIMC device.

config VIDEO_FIMC_DEBUG
	bool "FIMC driver debug messages"
	depends on VIDEO_FIMC

config VIDEO_FIMC_MIPI
	bool "FIMC works with MIPI-CSI2 (Rx)"
	depends on VIDEO_FIMC && ARCH_S5PC1XX

source "drivers/media/video/samsung/fimc/Kconfig-camera"

config VIDEO_FIMC_CAM_CH
	int "External Camera channel (0=A, 1=B)"
	depends on VIDEO_FIMC
	default "0"

config VIDEO_FIMC_CAM_RESET
	int "Reset Type (0=low, 1=high)"
	depends on VIDEO_FIMC
	default "0"
```

## backfire_10.03.1/target/linux/s3c64xx/files-2.6.36/drivers/media/video/samsung/g2d/Kconfig
```kconfig
#
# Configuration for FIMG-2D
#

config VIDEO_G2D
	bool "Samsung FIMG-2D Driver" 
	depends on VIDEO_SAMSUNG && (CPU_S3C6410 || CPU_S5PC100)
	default n
	---help---
	  This is a FIMG-2D(2D accelerator) driver for Samsung S3C6410 and S5PC100.
```

## backfire_10.03.1/target/linux/s3c64xx/files-2.6.36/drivers/media/video/samsung/g3d/Kconfig
```kconfig
#
# Configuration for FIMG-3D
#

config VIDEO_G3D
	bool "Samsung FIMG-3D Driver" 
	depends on VIDEO_SAMSUNG && (CPU_S3C6410 || CPU_S5PC100)
	default n
	---help---
	  This is a FIMG-3D(3D accelerator) driver for Samsung S3C6410 and S5PC100.
```

## backfire_10.03.1/target/linux/s3c64xx/files-2.6.36/drivers/media/video/samsung/jpeg/Kconfig
```kconfig
#
# Configuration for JPEG
#

config VIDEO_JPEG
	bool "Samsung JPEG driver" 
	depends on VIDEO_SAMSUNG && CPU_S3C6410
	default n
	---help---
	  This is a JPEG for Samsung S3C6410.	  
```

## backfire_10.03.1/target/linux/s3c64xx/files-2.6.36/drivers/media/video/samsung/jpeg_v2/Kconfig
```kconfig
#
# Configuration for JPEG
#

config VIDEO_JPEG_V2
	bool "Samsung JPEG driver" 
	depends on VIDEO_SAMSUNG && CPU_S5PC100
	default n
	---help---
	  This is a JPEG for Samsung S5PC100
```

## backfire_10.03.1/target/linux/s3c64xx/files-2.6.36/drivers/media/video/samsung/mfc10/Kconfig
```kconfig
#
# Configuration for Multi Format Codecs (MFC)
#

config VIDEO_MFC10
	bool "Samsung FIMV V1.0 - MFC (Multi Format Codec) Driver" 
	depends on VIDEO_SAMSUNG && (CPU_S3C6410 || CPU_S3C6400)
	default n
	---help---
	  This is a Multi Format Codecs (MFC) driver for Samsung S3C6400 and s3C6410.

config VIDEO_MFC_DEBUG
	bool "print MFC debug message"
	depends on VIDEO_MFC10
	default n
```

## backfire_10.03.1/target/linux/s3c64xx/files-2.6.36/drivers/media/video/samsung/post/Kconfig
```kconfig
#
# Configuration for Post Porcessor
#

config VIDEO_POST
	bool "Samsung Post Processor Driver" 
	depends on VIDEO_SAMSUNG && (ARCH_S3C64XX || ARCH_S5P64XX)
	default n
	---help---
	  This is a post processor driver for Samsung S3C6410 and S5P6440.
```

## backfire_10.03.1/target/linux/s3c64xx/files-2.6.36/drivers/media/video/samsung/tv/Kconfig
```kconfig
#
# Configuration for Post Porcessor
#

config VIDEO_TV
	bool "Samsung TV Driver" 
	depends on VIDEO_SAMSUNG && CPU_S3C6410
	default n
	---help---
	  This is a TV driver for Samsung S3C6410.
```

## backfire_10.03.1/target/linux/s3c64xx/files-2.6.36/drivers/video/samsung/Kconfig
```kconfig
config FB_S3C_EXT
	tristate "S3C Framebuffer Support (eXtended)"
	select FB_CFB_FILLRECT
	select FB_CFB_COPYAREA
	select FB_CFB_IMAGEBLIT
	depends on FB && (ARCH_S3C64XX || ARCH_S5P64XX || ARCH_S5PC1XX)

	default y if VIDEO_SAMSUNG
	---help---
	TBA

choice
	depends on FB_S3C_EXT
	prompt "Select LCD Type"
	default FB_S3C_EXT_TFT480272

config FB_S3C_EXT_TFT480272
		boolean "4.3 inch 480x272 TFT LCD"
		help
		  4.3 inch 480x272 TFT LCD

config FB_S3C_EXT_TFT800480
		boolean "7 inch 800x480 TFT LCD"
		help
		  7 inch 800x480 TFT LCD

config FB_S3C_EXT_T240320
		boolean "3.5 inch 240X320 Toppoly LCD"
		help
		  3.5 inch 240X320 Toppoly LCD

config FB_S3C_EXT_X240320
		boolean "3.5 inch 240X320 LCD(ACX502BMU)"
		help
		  3.5 inch 240X320 LCD(ACX502BMU)

config FB_S3C_EXT_TFT640480
		boolean "8 inch 640X480 L80 LCD"
		help
		  8 inch 640X480 LCD

config FB_S3C_EXT_VGA1024768
		boolean "VGA 1024x768"
		help
		  VGA 1024x768

config FB_S3C_EXT_VGA800600
		boolean "VGA 800x600"
		help
		  VGA 800x600

config FB_S3C_EXT_VGA640480
		boolean "VGA 640x480"
		help
		  VGA 640x480

config FB_S3C_EXT_EZVGA800600
		boolean "EZVGA 800x600"
		help
		  EZVGA 800x600
endchoice

config FB_S3C_EXT_BPP
	tristate "Advanced options for S3C Framebuffer"
	depends on FB_S3C_EXT
	default n
	---help---
	TBA

choice
	depends on FB_S3C_EXT_BPP
	prompt "Select BPP(Bits Per Pixel)"
	default FB_S3C_EXT_BPP_16

config FB_S3C_EXT_BPP_8
		bool "8 BPP"
		---help---
		TBA

config FB_S3C_EXT_BPP_16
		bool "16 BPP"
		---help---
		TBA

config FB_S3C_EXT_BPP_24
		bool "24 BPP(XRGB888)"
		---help---
		TBA

config FB_S3C_EXT_BPP_28
		bool "28 BPP(ARGB4888)"
		---help---
		TBA

config FB_S3C_EXT_BPP_32
		bool "32 BPP(ARGB8888)"
		---help---
		TBA
endchoice

config FB_S3C_EXT_NUM
	int "Number of Framebuffers"
	depends on FB_S3C_EXT_BPP && (ARCH_S3C64XX || ARCH_S5P64XX || ARCH_S5PC1XX)
	default "1"
	---help---
	TBA

config FB_S3C_EXT_VIRTUAL_SCREEN
	bool "Enable Virtual Screen"
	depends on FB_S3C_EXT_BPP

	default n
	---help---
	TBA

config FB_S3C_EXT_DOUBLE_BUFFERING
	bool "Enable Double Buffering"
	depends on FB_S3C_EXT_BPP

	default n
	---help---
	TBA
```

## backfire_10.03.1/target/linux/s5pc1xx/files-2.6.35/sound/soc/s5pv2xx/Kconfig
```kconfig
config SND_S5PV2XX_SOC
	tristate "Samsung S5P Audio Drivers"
	depends on ARCH_S5PV210
	help
	  Say Y or M if you want to add support for codecs attached to
	  the S5PV210 AC97 or I2S interfaces. You will also need to
	  select the audio interfaces to support below.

config SND_S3C_I2SV2_SOC
	tristate

config SND_S3C_NEW_DMA
	tristate
	default y if ANDROID

config SND_S5PC1XX_SOC_I2S
	tristate
	select SND_S3C_I2SV2_SOC

config SND_SOC_WM8960_MINI210
	tristate

config SND_S5PV2XX_SOC_WM8960
	tristate "SoC I2S Audio support for WM8960 on MINI210"
	depends on SND_S5PV2XX_SOC
	select SND_SOC_WM8960_MINI210
	select SND_S5PC1XX_SOC_I2S
	help
	  Say Y if you want to add support for SoC audio on the MINI210.

config S5P_INTERNAL_DMA
	bool "IIS operate with Internal DMA"
	depends on SND_S5PV2XX_SOC_WM8960
	default y
	help
	  Say Y for IIS to operate with Internal DMA(IIS's own DMA)
```
